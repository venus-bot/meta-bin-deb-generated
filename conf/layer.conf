## conf/layer.conf
```bitbake
# add conf and classes directory to BBPATH
BBPATH := "${BBPATH}:${LAYERDIR}"

# add the recipes to BBFILES
BBFILES := "${BBFILES} \
	${LAYERDIR}/meta-generated/${DISTRO}/*.bb \
"

BBFILE_COLLECTIONS += "meta-bin-deb-generated"
BBFILE_PATTERN_meta-bin-deb-generated := "^${LAYERDIR}/"
BBFILE_PRIORITY_meta-bin-deb-generated = "30"

BINDEBBASE = '${@os.path.normpath("${LAYERDIR}")}'

LAYERSERIES_COMPAT_meta-bin-deb-generated = "zeus dunfell"
```
